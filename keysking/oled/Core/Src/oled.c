#include "oled.h"
#include "string.h"
#define OLED_ADDRESS 0x7A

void OLED_SendCmd(uint8_t cmd)
{
	uint8_t SendBuffer[2];
	SendBuffer[0] = 0x00;
	SendBuffer[1] = cmd;
	HAL_I2C_Master_Transmit(&hi2c1, OLED_ADDRESS, SendBuffer , 2, HAL_MAX_DELAY);
}


void OLED_Init()
{
	OLED_SendCmd(0xAE); /*关闭显示 display off*/

	  OLED_SendCmd(0x02); /*设置列起始地址 set lower column address*/
	  OLED_SendCmd(0x10); /*设置列结束地址 set higher column address*/

	  OLED_SendCmd(0x40); /*设置起始行 set display start line*/

	  OLED_SendCmd(0xB0); /*设置页地址 set page address*/

	  OLED_SendCmd(0x81); /*设置对比度 contract control*/
	  OLED_SendCmd(0xCF); /*128*/

	  OLED_SendCmd(0xA1); /*设置分段重映射 从右到左 set segment remap*/

	  OLED_SendCmd(0xA6); /*正向显示 normal / reverse*/

	  OLED_SendCmd(0xA8); /*多路复用率 multiplex ratio*/
	  OLED_SendCmd(0x3F); /*duty = 1/64*/

	  OLED_SendCmd(0xAD);
	  OLED_SendCmd(0x8B);

	  OLED_SendCmd(0x33);

	  OLED_SendCmd(0xC8);

	  OLED_SendCmd(0xD3);
	  OLED_SendCmd(0x00);

	  OLED_SendCmd(0xD5);
	  OLED_SendCmd(0xC0);

	  OLED_SendCmd(0xD9);
	  OLED_SendCmd(0x1F);

	  OLED_SendCmd(0xDA);
	  OLED_SendCmd(0x12);

	  OLED_SendCmd(0xDB);
	  OLED_SendCmd(0x40);

	  OLED_SendCmd(0xAF);
}

uint8_t GRAM[8][128];

void OLED_NewFrame()
{
	memset(GRAM,0,sizeof(GRAM));
}

const uint8_t DSCF0467_1Data[] = {
0xf0, 0xf0, 0xe0, 0xe0, 0xe0, 0xe0, 0xe0, 0xc0, 0xc0, 0xc0, 0xc0, 0xc0, 0x80, 0x80, 0x80, 0x80, 0x80, 0x00, 0x00, 0x00, 0x00, 0x00, 0x00, 0x00,
0x00, 0x00, 0x00, 0x00, 0x00, 0x00, 0x00, 0x00, 0x00, 0x00, 0x00, 0x00, 0x00, 0x01, 0x01, 0x01, 0x03, 0x03, 0x03, 0x07, 0x07, 0x07, 0x0f, 0x0f,
0x0f, 0x0f, 0x0f, 0x10, 0x1c, 0x3c, 0x3c, 0x3c, 0x38, 0x78, 0x70, 0xf8, 0xf0, 0x00, 0x00, 0xe0, 0x00, 0x80, 0x00, 0x00, 0x00, 0x00, 0x00, 0x00,
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0x00, 0x00, 0x00, 0x00, 0x00, 0x00, 0x00, 0xf8, 0x00, 0xff, 0x80, 0x00, 0xff, 0xff, 0xff, 0xff,
};
//const Image DSCF0467_1Img = {128, 64, DSCF0467_1Data};

const uint8_t DSCF0467_0Data[] = {
0x0f, 0x0f, 0x1f, 0x1f, 0x1f, 0x1f, 0x1f, 0x3f, 0x3f, 0x3f, 0x3f, 0x3f, 0x7f, 0x7f, 0x7f, 0x7f, 0x7f, 0xff, 0xff, 0xff, 0xff, 0xff, 0xff, 0xff,
0xff, 0xff, 0xff, 0xff, 0xff, 0xff, 0xff, 0xff, 0xff, 0xff, 0xff, 0xff, 0xff, 0xfe, 0xfe, 0xfe, 0xfc, 0xfc, 0xfc, 0xf8, 0xf8, 0xf8, 0xf0, 0xf0,
0xf0, 0xf0, 0xf0, 0xef, 0xe3, 0xc3, 0xc3, 0xc3, 0xc7, 0x87, 0x8f, 0x07, 0x0f, 0xff, 0xff, 0x1f, 0xff, 0x7f, 0xff, 0xff, 0xff, 0xff, 0xff, 0xff,
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0xff, 0xff, 0xff, 0xff, 0xff, 0xff, 0xff, 0x07, 0xff, 0x00, 0x7f, 0xff, 0x00, 0x00, 0x00, 0x00,
};
//const Image DSCF0467_0Img = {128, 64, DSCF0467_0Data};


void OLED_ShowFrame1()
{
	uint8_t SendBuffer[129];
	SendBuffer[0] = 0x40;
	for(uint8_t i = 0; i < 8; i++)
	{
		for(uint8_t j=0;j<128;j++)
		{
			SendBuffer[j+1] = DSCF0467_1Data[i*128+j];
		}
		OLED_SendCmd(0xB0 + i);
		OLED_SendCmd(0x02);
		OLED_SendCmd(0x10);
		HAL_I2C_Master_Transmit(&hi2c1, OLED_ADDRESS, SendBuffer, sizeof(SendBuffer), HAL_MAX_DELAY);
	}
}

void OLED_ShowFrame0()
{
	uint8_t SendBuffer[129];
	SendBuffer[0] = 0x40;
	for(uint8_t i = 0; i < 8; i++)
	{
		for(uint8_t j=0;j<128;j++)
		{
			SendBuffer[j+1] = DSCF0467_0Data[i*128+j];
		}
		OLED_SendCmd(0xB0 + i);
		OLED_SendCmd(0x02);
		OLED_SendCmd(0x10);
		HAL_I2C_Master_Transmit(&hi2c1, OLED_ADDRESS, SendBuffer, sizeof(SendBuffer), HAL_MAX_DELAY);
	}
}

void OLED_SetPixel(uint8_t x,uint8_t y)
{
	if(x>=128||y>=64) return ;
	GRAM[y/8][x] |= 0x01 << (y%8);
}

void OLED_Test()
{
	OLED_SendCmd(0xB0);
	OLED_SendCmd(0x02);
	OLED_SendCmd(0x10);

	uint8_t SendBuffer[] = {0x40,0xAA,0xAA,0xAA,0xAA,0xAA,0xAA,0xAA,0xAA,0xAA,0xAA,0xAA,0xAA,0xAA,0xAA,0xAA,0xAA,0xAA,0xAA,0xAA,0xAA,0xAA,0xAA,0xAA,0xAA,0xAA,0xAA,0xAA,0xAA,0xAA,0xAA,0xAA,0xAA,0xAA};
	HAL_I2C_Master_Transmit(&hi2c1, OLED_ADDRESS, SendBuffer, sizeof(SendBuffer), HAL_MAX_DELAY);


}
